## apps/imu/Kconfig
```kconfig
#
# For a description of the syntax of this configuration file,
# see the file kconfig-language.txt in the NuttX tools repository.
#

config EXAMPLE_MOTOR_IMU_DATA
	tristate "Motor IMU Data Example"
	default n
	---help---
		Enable the Motor IMU Data example
```

## apps/motor_sensing/Kconfig
```kconfig
#
# For a description of the syntax of this configuration file,
# see the file kconfig-language.txt in the NuttX tools repository.
#

config EXAMPLE_MOTOR_SENSING
	tristate "Motor Sensing Example"
	default n
	---help---
		Enable the Motor Sensing example
```

## apps/qencoder/Kconfig
```kconfig
#
# For a description of the syntax of this configuration file,
# see the file kconfig-language.txt in the NuttX tools repository.
#

config EXAMPLE_QENCODER_MOTOR
	tristate "QEncoder Motor Example"
	default n
	---help---
		Enable the QEncoder Motor example
```
